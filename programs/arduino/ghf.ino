#include <AccelStepper.h> //подключаем библиотеку AccelStepper
#include<SoftwareSerial.h>
//указываем к каким пинам подключен драйвер с шаговым двигателем
AccelStepper LeftStepper(1, 2, 5); // pin 2 = step, pin 5 = direction
AccelStepper RightStepper(1, 3, 6); // pin 3 = step, pin 6 = direction

//Создаем необходимые переменные
int Lspeed; //Скорость левого двигателя шагов/секунду
int Rspeed; //Скорость правого двигателя шагов/скунду
String data = "0000000";//Получаемая с телефона команда
String dataPrev;//Предыдущая полученная с телефона команда
bool zero;//маркер остановки
int button = 2;//Нажатая кнопка на телефоне по умолчанию 2
int power = 0;//Скорость полученная с телефона
int angle;//Угол, полученный с телефона
String block = "0";//Команда с пишки для остановки/замедления перед препятствием
long comand;//Числовое значение команды с телефона
bool stop_mode = false;//Маокер активации режима остановки перед препятствием

//Задаем лимиты скорости на различные режимы
int limit1 = 3000;//Для 1 режима
int limit2 = 6000;//Для 2 режима
int limit3 = 9000;//ДЛЯ 3 режима

int limit = limit2;//Задаем режим работы по умолчанию

int minlim = 200;//устанавливаем минимальную скорость

SoftwareSerial Bluetooth(4,7);//Показываем к каким пинам подключен Bluetooth модуль

void setup() {
  Serial.begin(9600);//Запускаем Serial для получения команд с пишки
  pinMode(8, OUTPUT); //Устанавливаем режим работы 8 пина, отвечающего за включение/отключение драйверов, на выход
  LeftStepper.setMaxSpeed(12000); //устанавливаем максимальную скорость левого шагового двигателя шагов/секунду
  LeftStepper.setAcceleration(7000); //устанавливаем максимальное ускорени левого шагового двигателя шагов/секунду в квадрате
  RightStepper.setMaxSpeed(12000); //устанавливаем максимальную скорость правого шагового двигателя шагов/секунду
  RightStepper.setAcceleration(7000); //устанавливаем максимальное ускорени правого шагового двигателя шагов/секунду в квадрате
  digitalWrite(8, LOW); //Подаем сигнал низкого уровня на 8 пин для включения драйверов
  Bluetooth.begin(38400); //Открываем канал предачи данных для получения команд с телефона
  Bluetooth.setTimeout(1);//Устанавливает timeOut времени чтения данных с канала
  zero = false;//Начальный маркер остановки false
  Lspeed = 0; //Задаем начальное значение скорости левого двигателя
  Rspeed = 0; //Задаем начальное значение скорости правого двигателя
  LeftStepper.setSpeed(Lspeed);//устанавливаем рассчитанную скорость на левый двигаетль
  RightStepper.setSpeed(Rspeed);//устанавливаем рассчитанную скорость на правый двигаетль
}

void loop() {
  if(stop_mode){//если режим остановки перед препятствием активирован
    if (Serial.available()>0){//если есть данные с пишики
      block = Serial.readStringUntil('#');//считываем их до спец символа
      if(((block=="1")&&(angle<=180))||((block=="2")&&(angle>180))){//Если получена информации по пути движения приравниваем скорости к 0
        Lspeed = 0;
        Rspeed = 0;
      }
      if(block=="0"){//если получена команда об удалении от препятсвия на нужное расстояние или исчезновения препятствия
        limit = speedMode(button);//восстанавливаем режим скорости
        if (power!=0){//если мы остановились из-за препятствия 
          calcSpeed(power, angle, limit);//возобновляем движение
        }
      }
      if(block == "4"){//если получена информации о приближении к препятствию
        limit = limit1;//переходит на минимальный режим скорости
        calcSpeed(power, angle, limit);//пересчиваем скорость в связи с изменением режима
      }
      LeftStepper.setSpeed(Lspeed);//устанавливаем рассчитанную скорость на левый двигатель
      RightStepper.setSpeed(Rspeed);//устанавливаем рассчитанную скорость на правый двигатель
    }
  }
  if (Bluetooth.available()>0){//если еть доступные данные то начинаем их прием и обработку
    data = Bluetooth.readStringUntil('#');//считваем данные из канала как строку
    if((data.length()==7)&&(dataPrev!=data)){//Если команда получена полностью и она не равна предыдущей
      dataPrev = data;//запоминаем команду
      comand = data.toInt();//переводим ее в long
      angle = comand/10000;//Выделяем угол 
      power = (comand%10000)/10;//Выделяем скорость
      if(comand%10==4){//Если нажата кнопка активации/деактивации режима остановки
        stop_mode = !stop_mode;//включаем/выключаем режим остановки
        block = "0";//задаем блок по умолчанию 0 - препятствий нет
      }else if((comand%10!=0)&&(block=="0")){//если нажата кнопка изменения режима скорости и препятствий нет
        button = comand%10;//запоминаем режим
        limit = speedMode(button);//задаем предел
      }
      if((comand/10==0)||((block=="1")&&(angle<=180))||((block=="2")&&(angle>180))){//если получена команда об остановке или о движении в препятсвие останавливаемся
        Lspeed = 0;
        Rspeed = 0;
      }else{//в ином случаем
        calcSpeed(power, angle, limit);//расчитываем скорости согласно полученой команде
      }
      LeftStepper.setSpeed(Lspeed);//устанавливаем рассчитанную скорость на левый двигатель
      RightStepper.setSpeed(Rspeed);//устанавливаем рассчитанную скорость на правый двигатель
    }
  }
  if (!zero){//если маркер остановки не активирован то запускаем двигатели с установленной скоростью
    LeftStepper.runSpeed();//запускаем левый двигатель
    RightStepper.runSpeed();//запускаем правый двигатель
  }
  if(Lspeed==0&&Rspeed==0&&!zero){//если получена команда остановки и маркер остановки еще не установлен
    zero=true;//включаем маркер остановки
    digitalWrite(8, HIGH);//отключаем драйвера
  }
}

//функция для изменения режима скорости соответсвенно нужной кнопке задает нужный режим
int speedMode(int mode){
  if(mode==1){
    return limit1;
  }else if(mode==2){
    return limit2;
  }else if(mode==3){
    return limit3;
  }
}


//Функция расчета скоростей для двигателей
void calcSpeed(int p, double a, int lim){
  p = map(p, 0, 100, minlim, lim);//пресчитываем силу от 0 до 100 в от нижнего до верхнего предела
  double ar = a/180*M_PI;//переводим угол в радианы
  if(a<=90){//если джостик в первой четверти
    Lspeed = p;//подаем полную скорость на левый трак
    Rspeed = trunc(p*sin(ar));//скорость для правого умножаем на синус угла и отбрасываем дробную часть
  }else if(a<=180){
    Rspeed = p;//подаем полную скорость на правый трак
    Lspeed = trunc(p*sin(ar));//скорость для левого умножаем на синус угла и отбрасываем дробную часть
  }else if(a<=270){
    Rspeed = -p;//подаем полную скорость умноженную на -1 на правый трак
    Lspeed = trunc(p*sin(ar));//скорость для правого умножаем на синус угла и отбрасываем дробную часть
  }else if(a<=360){
    Lspeed = -p;//подаем полную скорость умноженную на -1 на левый трак
    Rspeed = trunc(p*sin(ar));//скорость для левого умножаем на синус угла и отбрасываем дробную часть
  }
  if (zero){//если был активен маркер остановки
    zero=false;//выключаем маркер остановки
    digitalWrite(8, LOW);//включаем драйвера
  }
}
